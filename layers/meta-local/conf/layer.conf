## layers/meta-local/conf/layer.conf
```bitbake
# Copyright (C) 2014 NEO-Technologies
# Released under the MIT license (see COPYING.MIT for the terms)

# We have a conf and classes directory, add to BBPATH
BBPATH .= ":${LAYERDIR}"

# We have recipes-* directories, add to BBFILES
BBFILES += "${LAYERDIR}/recipes-*/*/*.bb ${LAYERDIR}/recipes-*/*/*.bbappend"

BBFILE_COLLECTIONS += "local"
BBFILE_PATTERN_local = "^${LAYERDIR}/"
BBFILE_PRIORITY_local = "10"

# This should only be incremented on significant changes that will
# cause compatibility issues with other layers
LAYERVERSION_local = "1"
LAYERSERIES_COMPAT_local = "kirkstone"
LAYERDEPENDS_local = "core rockchip"
```
